## board/ti/bachelor/Kconfig
```kconfig
if TARGET_BACHELOR

config SYS_BOARD
	default "bachelor"

config SYS_VENDOR
	default "ti"

config SYS_SOC
	default "am33xx"

config SYS_CONFIG_NAME
	default "bachelor"

endif
```
